## config/boards/shields/dasbob/Kconfig.defconfig
```kconfig
if SHIELD_DASBOB_DONGLE

config ZMK_KEYBOARD_NAME
    default "DASBOB"

config ZMK_SPLIT_ROLE_CENTRAL
    default y

config ZMK_SPLIT_BLE_CENTRAL_PERIPHERALS
    default 2

config ZMK_USB
    default y

config ZMK_SPLIT
	default y

config ZMK_BLE
    default y

endif

if SHIELD_DASBOB_LEFT || SHIELD_DASBOB_RIGHT

config ZMK_SPLIT
	default y

config ZMK_BLE
    default y

endif
```

## config/west.yml
```yaml
manifest:
  remotes:
    - name: zmkfirmware
      url-base: https://github.com/zmkfirmware
    - name: carrefinho
      url-base: https://github.com/carrefinho
    # - name: janpfischer
    #   url-base: https://github.com/janpfischer
  projects:
    - name: zmk
      remote: zmkfirmware
      revision: v0.3.0
      import: app/west.yml
    - name: prospector-zmk-module
      remote: carrefinho
      revision: fix/stability
    # - name: zmk-dongle-screen
    #   remote: janpfischer
    #   revision: 0.1.2
  self:
    path: config
```
